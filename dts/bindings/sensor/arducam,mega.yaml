## dts/bindings/sensor/arducam,mega.yaml
```yaml
# Copyright (c) 2023, Torbjorn Ovrebekk
# SPDX-License-Identifier: Apache-2.0

description: |
    Arducam Mega spi camera module
compatible: "nordic,arducam_mega"

include: spi-device.yaml
```

## modules/arducam_mega/lib/Kconfig
```kconfig
#
# Copyright (c) 2022 Nordic Semiconductor
#
# SPDX-License-Identifier: LicenseRef-Nordic-5-Clause
#

menu "App uart module"

rsource "arducam_mega/Kconfig"

endmenu
```

## modules/arducam_mega/lib/arducam_mega/Kconfig
```kconfig
#
# Copyright (c) 2022 Nordic Semiconductor
#
# SPDX-License-Identifier: LicenseRef-Nordic-5-Clause
#

menuconfig ARDUCAM_MEGA
	bool "Driver for the Arducam Mega camera module"
	depends on SPI
	select RING_BUFFER
	help
		Enable driver for the Arducam Mega camera module
		
if ARDUCAM_MEGA

config ARDUCAM_MEGA_EVT_THREAD_STACK_SIZE
	int "Event thread stack size"
	default 1024
	help
	  Stack size of the event handler thread, used to run the application event handler. 

config ARDUCAM_MEGA_EVT_THREAD_PRIORITY
	int "Event thread priority"
	default 5
	help
	  The priority of the event handler thread

endif # ARDUCAM_MEGA
```
